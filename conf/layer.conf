## conf/layer.conf
```bitbake
# We have a conf and classes directory, add to BBPATH
BBPATH .= ":${LAYERDIR}"

# We have a packages directory, add to BBFILES
BBFILES += "${LAYERDIR}/recipes-*/*/*.bb \
            ${LAYERDIR}/recipes-*/*/*.bbappend"

BBFILE_COLLECTIONS += "coral"
BBFILE_PATTERN_coral := "^${LAYERDIR}/"
BBFILE_PRIORITY_coral = "6"
LAYERSERIES_COMPAT_coral = "thud warrior"

LAYERDEPENDS_coral = "core freescale-layer"
```

## conf/machine/coral-dev.conf
```bitbake
#@TYPE: Machine
#@NAME: Google Coral Dev Board
#@SOC: i.MX8MQ
#@DESCRIPTION: Machine configuration for Google Coral Dev Board
#@MAINTAINER: Mirza Krak <mirza@mkrak.org>

MACHINEOVERRIDES =. "mx8mq:"

require conf/machine/include/imx-base.inc
require conf/machine/include/arm/armv8a/tune-cortexa53.inc

# Mainline BSP defaults to "generic" cortexa53 configuration,
# adjust it here to include crypto extension which enables
# inline NEON and FPU code generation
DEFAULTTUNE:use-mainline-bsp = "cortexa53-crypto"

PREFERRED_PROVIDER_virtual/kernel:use-mainline-bsp = "linux-fslc-lts"
PREFERRED_PROVIDER_virtual/kernel:use-nxp-bsp = "linux-coral"

MACHINE_FEATURES += "pci wifi bluetooth bcm43455 bcm4356"
MACHINE_FEATURES:append:use-nxp-bsp = " optee bcm4359"

MACHINE_EXTRA_RDEPENDS += "\
    kernel-modules \
    libedgetpu \
"

MACHINE_SOCARCH_FILTER:append:mx8mq = " virtual/libopenvg virtual/libgles1 virtual/libgles2 virtual/egl virtual/mesa virtual/libgl virtual/libg2d"

KERNEL_DEVICETREE:use-nxp-bsp = "freescale/fsl-imx8mq-phanbell.dtb"
KERNEL_DEVICETREE:use-mainline-bsp = "freescale/imx8mq-phanbell.dtb"

IMX_DEFAULT_BOOTLOADER = "u-boot-coral"

UBOOT_SUFFIX = "bin"

UBOOT_CONFIG ??= "sd"
UBOOT_CONFIG[sd] = "imx8mq_phanbell_defconfig,sdcard"
UBOOT_CONFIG[mfgtool]  = "imx8mq_phanbell_defconfig"

SPL_BINARY = "spl/u-boot-spl.bin"

# Set DDR FIRMWARE
DDR_FIRMWARE_NAME = "\
    lpddr4_pmu_train_1d_imem.bin \
    lpddr4_pmu_train_1d_dmem.bin \
    lpddr4_pmu_train_2d_imem.bin \
    lpddr4_pmu_train_2d_dmem.bin \
"

# Set u-boot DTB
UBOOT_DTB_NAME = "fsl-imx8mq-phanbell.dtb"

# Set ATF platform name
ATF_PLATFORM = "imx8mq"

# Set imx-mkimage boot target
IMXBOOT_TARGETS = "flash_evk flash_evk_no_hdmi flash_dp_evk"
IMX_BOOT_SOC_TARGET = "iMX8M"

# Set Serial console
SERIAL_CONSOLE = "115200 ttymxc0"

LOADADDR = ""
UBOOT_MAKE_TARGET = ""
IMX_BOOT_SEEK = "33"

OPTEE_BIN_EXT = "8mq"

IMAGE_BOOT_FILES += "boot.scr"

WKS_FILE = "coral-bootpart.wks.in"
```

## meta-coral-bsp/conf/machine/coral-dev.conf
```bitbake
#@TYPE: Machine
#@NAME: Google Coral Dev Board
#@SOC: i.MX8MQ
#@DESCRIPTION: Machine configuration for Google Coral Dev Board
#@MAINTAINER: Mirza Krak <mirza@mkrak.org>

MACHINEOVERRIDES =. "mx8:mx8m:mx8mq:"

WKS_FILE ?= "coral-bootpart.wks.in"

require conf/machine/include/imx-base.inc
require conf/machine/include/tune-cortexa53.inc

PREFERRED_PROVIDER_virtual/kernel ??= "linux-imx"

PREFERRED_PROVIDER_u-boot ??= "u-boot-coral"
PREFERRED_PROVIDER_virtual/bootloader ??= "u-boot-coral"

MACHINE_FEATURES += "wifi bluetooth optee qca6174"

MACHINE_EXTRA_RDEPENDS += "\
    kernel-modules \
    libedgetpu \
    firmware-qca6174 \
    kernel-module-qca6174 \
"

MACHINE_SOCARCH_FILTER_append_mx8mq = " \
    virtual/libopenvg \
    virtual/libgles1 \
    virtual/libgles2 \
    virtual/egl \
    virtual/mesa \
    virtual/libgl \
    virtual/libg2d \
"

KERNEL_DEVICETREE = "\
    freescale/fsl-imx8mq-phanbell.dtb \
    freescale/fsl-imx8mq-yorktown.dtb \
"

IMAGE_BOOTFILES += "\
    imx8mq_m4_TCM_hello_world.bin \
    imx8mq_m4_TCM_rpmsg_lite_pingpong_rtos_linux_remote.bin \
    imx8mq_m4_TCM_rpmsg_lite_str_echo_rtos.bin \
"

UBOOT_CONFIG ??= "sd"
UBOOT_CONFIG[sd] = "mx8mq_phanbell_defconfig,sdcard"

SPL_BINARY = "spl/u-boot-spl.bin"

# Set DDR FIRMWARE
DDR_FIRMWARE_NAME = "\
    lpddr4_pmu_train_1d_imem.bin \
    lpddr4_pmu_train_1d_dmem.bin \
    lpddr4_pmu_train_2d_imem.bin \
    lpddr4_pmu_train_2d_dmem.bin \
"

# Set u-boot DTB
UBOOT_DTB_NAME = "fsl-imx8mq-phanbell.dtb"

# Set imx-mkimage boot target
IMXBOOT_TARGETS = "flash_evk flash_evk_no_hdmi"

# Set Serial console
SERIAL_CONSOLE = "115200 ttymxc0"

IMAGE_BOOTLOADER = "imx-boot"
BOOT_SPACE = "65536"
IMX_BOOT_SEEK = "33"

LOADADDR = ""

OPTEE_BIN_EXT = "8mq"

IMAGE_BOOT_FILES += "boot.scr"

# Use gstreamer 1.14 from meta-freescale
PREFERRED_VERSION_gstreamer1.0 ?= "1.14.imx"
PREFERRED_VERSION_gstreamer1.0-plugins-base ?= "1.14.imx"
PREFERRED_VERSION_gstreamer1.0-plugins-good ?= "1.14.imx"
PREFERRED_VERSION_gstreamer1.0-plugins-bad ?= "1.14.imx"
PREFERRED_VERSION_gstreamer1.0-libav ?= "1.14.0"

MACHINE_GSTREAMER_1_0_PLUGIN = "imx-gst1.0-plugin"
```

## meta-coral-demo/conf/layer.conf
```bitbake
# We have a conf and classes directory, add to BBPATH
BBPATH .= ":${LAYERDIR}"

# We have a packages directory, add to BBFILES
BBFILES += "${LAYERDIR}/recipes-*/*/*.bb \
            ${LAYERDIR}/recipes-*/*/*.bbappend"

BBFILE_COLLECTIONS += "coral-demo"
BBFILE_PATTERN_coral-demo := "^${LAYERDIR}/"
BBFILE_PRIORITY_coral-demo = "10"
LAYERSERIES_COMPAT_coral-demo = "zeus"

LAYERDEPENDS_coral-demo = "coral-bsp fsl-demos"
```

## recipes-kernel/linux/linux-imx/coral-dev/defconfig
```kconfig
CONFIG_IKCONFIG=y
CONFIG_ANDROID_PARANOID_NETWORK=n
CONFIG_BRCMFMAC=n
CONFIG_BRCMFMAC_SDIO=n
CONFIG_BRCMUTIL=n
CONFIG_BUILD_ARM_APPENDED_DTB_IMAGE=n
CONFIG_KERNEL_GZIP=y
CONFIG_KERNEL_LZO=n
CONFIG_REGULATOR_BD71837=y
CONFIG_MFD_BD71837=y
CONFIG_LOG_BUF_SHIFT=17
CONFIG_WLAN=y
CONFIG_ATH10K=n

CONFIG_I2C=y
CONFIG_I2C_CHARDEV=y
CONFIG_SND_SOC_FSL_ASOC_CARD=n
CONFIG_SND_GOOGLE_EDGETPU_CARD=y
CONFIG_SND_SOC_RT5645=y
CONFIG_SND_SOC_RT5631=y
CONFIG_SND_SOC_RL6231=y
CONFIG_MFD_BD71837=y
CONFIG_REGULATOR_BD71837=y
CONFIG_MXC_CAMERA_OV5645_MIPI_V2=y
CONFIG_SPI_IMX=y
CONFIG_PCIEASPM_POWERSAVE=n
CONFIG_PCIEASPM_POWER_SUPERSAVE=y
CONFIG_LOCALVERSION_AUTO=n
CONFIG_IMX8MQ_PHANBELL_POWERSAVE=n
CONFIG_DRM_PANEL_TIANMA_S6D6FP0A2=y
CONFIG_STAGING_GASKET_FRAMEWORK=y
CONFIG_STAGING_APEX_DRIVER=y
CONFIG_USB_GADGET=y
CONFIG_USB_GADGETFS=y
CONFIG_USB_FUNCTIONFS=y
CONFIG_USB_FUNCTIONFS_GENERIC=y
CONFIG_USB_LIBCOMPOSITE=y
CONFIG_CONFIGFS_FS=y
CONFIG_CONFIGFS_F_FS=y
CONFIG_CONFIGFS_F_MTP=y
CONFIG_CONFIGFS_F_PTP=y
CONFIG_CONFIGFS_F_UEVENT=y
CONFIG_USB_F_FS=y
CONFIG_USB_F_ACM=y
CONFIG_USB_GADGETFS=y
CONFIG_GOOGLE_APEX_POWER=n

CONFIG_USB_G_HID=y
CONFIG_USB_SERIAL=y
CONFIG_USB_SERIAL_CP210X=y
CONFIG_MXC_GPU_VIV=n

CONFIG_HWMON=y
CONFIG_SENSORS_GPIO_FAN=y
CONFIG_PMBUS=y
CONFIG_SENSORS_INA233=m
CONFIG_LEDS_KTD202X=y
CONFIG_USB_USB5744=m
CONFIG_I2C_MUX=y
CONFIG_I2C_MUX_PCA954x=m
CONFIG_INPUT_TOUCHSCREEN=y
CONFIG_TOUCHSCREEN_SEC_TS_1223=m

CONFIG_MD=y
CONFIG_BLK_DEV_DM=m
CONFIG_BLK_DEV_THROTTLING=y
CONFIG_DM_CRYPT=m

CONFIG_IP_NF_ARPTABLES=m
CONFIG_IP_NF_FILTER=m
CONFIG_IP_NF_IPTABLES=m
CONFIG_IP_NF_MANGLE=m
CONFIG_IP_NF_MATCH_AH=m
CONFIG_IP_NF_MATCH_ECN=m
CONFIG_IP_NF_MATCH_RPFILTER=m
CONFIG_IP_NF_MATCH_TTL=m
CONFIG_IP_NF_NAT=m
CONFIG_IP_NF_RAW=m
CONFIG_IP_NF_SECURITY=m
CONFIG_IP_NF_TARGET_CLUSTERIP=m
CONFIG_IP_NF_TARGET_ECN=m
CONFIG_IP_NF_TARGET_MASQUERADE=m
CONFIG_IP_NF_TARGET_NETMAP=m
CONFIG_IP_NF_TARGET_REDIRECT=m
CONFIG_IP_NF_TARGET_REJECT=m
CONFIG_IP_NF_TARGET_SYNPROXY=m
CONFIG_IP_NF_TARGET_TTL=m
CONFIG_IP6_NF_IPTABLES=m
CONFIG_IP6_NF_MATCH_AH=m
CONFIG_IP6_NF_MATCH_EUI64=m
CONFIG_IP6_NF_MATCH_FRAG=m
CONFIG_IP6_NF_MATCH_OPTS=m
CONFIG_IP6_NF_MATCH_HL=m
CONFIG_IP6_NF_MATCH_IPV6HEADER=m
CONFIG_IP6_NF_MATCH_MH=m
CONFIG_IP6_NF_MATCH_RPFILTER=m
CONFIG_IP6_NF_MATCH_RT=m
CONFIG_IP6_NF_TARGET_HL=m
CONFIG_IP6_NF_FILTER=m
CONFIG_IP6_NF_TARGET_REJECT=m
CONFIG_IP6_NF_TARGET_SYNPROXY=m
CONFIG_IP6_NF_MANGLE=m
CONFIG_IP6_NF_RAW=m
CONFIG_IP6_NF_SECURITY=m
CONFIG_IP6_NF_NAT=m
CONFIG_IP6_NF_TARGET_MASQUERADE=m
CONFIG_IP6_NF_TARGET_NPT=m
CONFIG_NF_CONNTRACK=m
CONFIG_NF_CONNTRACK_AMANDA=m
CONFIG_NF_CONNTRACK_EVENTS=m
CONFIG_NF_CONNTRACK_FTP=m
CONFIG_NF_CONNTRACK_H323=m
CONFIG_NF_CONNTRACK_IPV4=m
CONFIG_NF_CONNTRACK_IPV6=m
CONFIG_NF_CONNTRACK_IRC=m
CONFIG_NF_CONNTRACK_MARK=m
CONFIG_NF_CONNTRACK_NETBIOS_NS=m
CONFIG_NF_CONNTRACK_PPTP=m
CONFIG_NF_CONNTRACK_PROCFS=m
CONFIG_NF_CONNTRACK_SANE=m
CONFIG_NF_CONNTRACK_SIP=m
CONFIG_NF_CONNTRACK_SNMP=m
CONFIG_NF_CONNTRACK_TFTP=m
CONFIG_NF_CONNTRACK_TIMEOUT=m
CONFIG_NF_CONNTRACK_TIMESTAMP=m
CONFIG_NF_TABLES=m
CONFIG_NF_TABLES_INET=y
CONFIG_NF_TABLES_NETDEV=y
CONFIG_NF_TABLES_BRIDGE=y
CONFIG_NF_TABLES_IPV4=y
CONFIG_NF_TABLES_IPV6=y
CONFIG_NF_TABLES_ARP=y
CONFIG_IP_VS=m
CONFIG_NETFILTER_XT_MATCH_IPVS=m
CONFIG_EXT4_FS_SECURITY=y

CONFIG_IIO=m
CONFIG_IIO_BUFFER=y
CONFIG_IIO_TRIGGER=y
CONFIG_TI_ADS1015=m

CONFIG_GPIO_PI4IOE5V6408=m
CONFIG_TPU_AKIRA=m
CONFIG_YORKTOWN_TPU=m

CONFIG_IMX_SDMA=m
CONFIG_CMA_DEBUGFS=y
CONFIG_CGROUP_FREEZER=y
CONFIG_CGROUP_NET_PRIO=y
CONFIG_CFS_BANDWIDTH=y
CONFIG_IP_VS_PROTO_TCP=y
CONFIG_IP_VS_PROTO_UDP=y
CONFIG_IP_VS_RR=m
CONFIG_VXLAN=m
CONFIG_XFRM_USER=m
CONFIG_INET_ESP=m
CONFIG_DUMMY=m
CONFIG_DM_THIN_PROVISIONING=m
```
